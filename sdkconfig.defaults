## sdkconfig.defaults
```kconfig
# ESP32-S3 Target
CONFIG_IDF_TARGET="esp32s3"

# CPU Frequency
CONFIG_ESP32S3_DEFAULT_CPU_FREQ_240=y

# PSRAM Configuration (Romeo ESP32-S3 has 8MB Octal PSRAM)
CONFIG_SPIRAM=y
CONFIG_SPIRAM_MODE_OCT=y
CONFIG_SPIRAM_SPEED_80M=y

# Camera framebuffer in PSRAM
CONFIG_CAMERA_FB_IN_PSRAM=y

# WiFi
CONFIG_ESP_WIFI_STATIC_RX_BUFFER_NUM=16
CONFIG_ESP_WIFI_DYNAMIC_RX_BUFFER_NUM=64
CONFIG_ESP_WIFI_DYNAMIC_TX_BUFFER_NUM=64

# HTTP Server
CONFIG_HTTPD_MAX_REQ_HDR_LEN=1024
```
